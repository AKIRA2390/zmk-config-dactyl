#include "dac_man_3x6.dtsi"
#include <dt-bindings/led/led.h>

&default_transform {
    col-offset = <6>;
};

&kscan0 {
    col-gpios
        = <&gpio0 19 GPIO_ACTIVE_HIGH>
        , <&gpio0 18 GPIO_ACTIVE_HIGH>
        , <&gpio0 10 GPIO_ACTIVE_HIGH>
        , <&gpio0 9 GPIO_ACTIVE_HIGH>
        , <&gpio0 1 GPIO_ACTIVE_HIGH>
	    , <&gpio0 0 GPIO_ACTIVE_HIGH>
        ;
};
