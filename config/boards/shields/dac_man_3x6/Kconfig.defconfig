## config/boards/shields/dac_man_3x6/Kconfig.defconfig
```kconfig
if SHIELD_DAC_MAN_3X6_LEFT

config ZMK_KEYBOARD_NAME
    default "Dac-Man-3x6-L"

config ZMK_SPLIT_BLE_ROLE_CENTRAL
    default y

endif

if SHIELD_DAC_MAN_3X6_RIGHT

config ZMK_KEYBOARD_NAME
    default "Dac-Man-3x6-R"

endif

if SHIELD_DAC_MAN_3X6_LEFT || SHIELD_DAC_MAN_3X6_RIGHT

config ZMK_SPLIT
    default y
endif
```

## config/boards/shields/dac_man_3x6/Kconfig.shield
```kconfig
config SHIELD_DAC_MAN_3X6_LEFT
    def_bool $(shields_list_contains,dac_man_3x6_left)

config SHIELD_DAC_MAN_3X6_RIGHT
    def_bool $(shields_list_contains,dac_man_3x6_right)
```

## config/west.yml
```yaml
manifest:
  remotes:
    - name: akira2390
      url-base: https://github.com/akira2390
  projects:
    - name: zmk
      remote: akira2390
      revision: core/move-to-zephyr-4-1
      import: app/west.yml
  self:
    path: config
```
